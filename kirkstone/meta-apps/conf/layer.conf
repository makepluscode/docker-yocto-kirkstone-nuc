## kirkstone/meta-apps/conf/layer.conf
```bitbake
# We have a conf and classes directory, add to BBPATH
BBPATH .= ":${LAYERDIR}"

# We have recipes-* directories, add to BBFILES
BBFILES += "${LAYERDIR}/recipes-*/*/*.bb \
            ${LAYERDIR}/recipes-*/*/*.bbappend"

BBFILE_COLLECTIONS += "meta-apps"
BBFILE_PATTERN_meta-apps = "^${LAYERDIR}/"
BBFILE_PRIORITY_meta-apps = "7"

LAYERSERIES_COMPAT_meta-apps = "kirkstone"
LAYERDEPENDS_meta-apps = "core qt5-layer" 
```

## kirkstone/meta-nuc/conf/layer.conf
```bitbake
# We set the layer compatibility for kirkstone
BBPATH .= ":${LAYERDIR}"
BBFILES += "${LAYERDIR}/recipes-*/*/*.bb \
            ${LAYERDIR}/recipes-*/*/*.bbappend"

BBFILE_COLLECTIONS += "meta-nuc"
BBFILE_PATTERN_meta-nuc = "^${LAYERDIR}/"
BBFILE_PRIORITY_meta-nuc = "10"

LAYERSERIES_COMPAT_meta-nuc = "kirkstone"

# Optional metadata
LAYERVERSION_meta-nuc = "1"
LAYERDEPENDS_meta-nuc = ""

# Layer-specific default settings
# You can move the following to a distro .conf or machine .conf if needed.
MACHINE ??= "intel-corei7-64"

DISTRO ?= "nodistro"
DISTRO_FEATURES:append = " systemd rauc"
DISTRO_FEATURES_BACKFILL_CONSIDERED += "sysvinit"
VIRTUAL-RUNTIME_init_manager = "systemd"
VIRTUAL-RUNTIME_initscripts = "systemd-compat-units"

PREFERRED_PROVIDER_virtual/grub-bootconf = "rauc-qemu-grubconf"
EFI_PROVIDER = "grub-efi"

IMAGE_FSTYPES = "ext4 wic"
DEPLOYABLE_IMAGE_TYPES = "ext4 wic"
IMAGE_TYPEDEP_wic = "ext4"

WKS_FILE = "image-installer.wks.in"
INITRD_IMAGE_LIVE = "core-image-minimal-initramfs"
do_image_wic[depends] += "${INITRD_IMAGE_LIVE}:do_image_complete"
do_rootfs[depends] += "virtual/kernel:do_deploy"

IMAGE_ROOTFS_EXTRA_SPACE = "0"
IMAGE_ROOTFS_SIZE = "2048000"

IMAGE_BOOT_FILES:append = "\
    ${KERNEL_IMAGETYPE} \
    microcode.cpio \
    ${IMGDEPLOYDIR}/${IMAGE_BASENAME}-${MACHINE}.ext4;rootfs.img \
    ${@bb.utils.contains('EFI_PROVIDER', 'grub-efi', 'grub-efi-bootx64.efi;EFI/BOOT/bootx64.efi', '', d)} \
    ${@bb.utils.contains('EFI_PROVIDER', 'grub-efi', '${IMAGE_ROOTFS}/boot/EFI/BOOT/grub.cfg;EFI/BOOT/grub.cfg', '', d)} \
    ${@bb.utils.contains('EFI_PROVIDER', 'systemd-boot', 'systemd-bootx64.efi;EFI/BOOT/bootx64.efi', '', d)} \
    ${@bb.utils.contains('EFI_PROVIDER', 'systemd-boot', '${IMAGE_ROOTFS}/boot/loader/loader.conf;loader/loader.conf', '', d)} \
    ${@bb.utils.contains('EFI_PROVIDER', 'systemd-boot', '${IMAGE_ROOTFS}/boot/loader/entries/boot.conf;loader/entries/boot.conf', '', d)} \
"

IMAGE_INSTALL:append = " \
    intel-nuc-init \
    rauc \
"
```

## kirkstone/meta-nuc/conf/local.conf.sample
```bitbake
# Intel NUC Machine Configuration
MACHINE ?= "intel-corei7-64"

# Local source code directory configuration
LOCAL ?= "/home/yocto/kirkstone/local"

# External source configuration for dashboard
EXTERNALSRC:pn-dashboard = "${LOCAL}/dashboard"
EXTERNALSRC_BUILD:pn-dashboard = "${WORKDIR}/build"

# External source configuration for service-app
EXTERNALSRC:pn-service-app = "${LOCAL}/service_app"
EXTERNALSRC_BUILD:pn-service-app = "${WORKDIR}/build"

# External source configuration for update-app
EXTERNALSRC:pn-update-app = "${LOCAL}/update_app"
EXTERNALSRC_BUILD:pn-update-app = "${WORKDIR}/build"

# External source configuration for update-agent
EXTERNALSRC:pn-update-agent = "${LOCAL}/update-agent"
EXTERNALSRC_BUILD:pn-update-agent = "${WORKDIR}/build"

# Target Device Configuration (SATA SSD)
ROOT_BLOCK_DEVICE_NAME = "sda"

# Build Optimization
BB_NUMBER_THREADS ?= "16"
PARALLEL_MAKE ?= "-j 16"

# Download and State Cache Directories (for faster rebuilds)
DL_DIR ?= "${TOPDIR}/../downloads"
SSTATE_DIR ?= "${TOPDIR}/../sstate-cache"

# Qt5 Configuration - OpenGL, KMS, and hardware acceleration support
PACKAGECONFIG:append:pn-qtbase = " eglfs kms gbm"

# Qt Git Protocol Configuration - Use HTTPS instead of git protocol
QT_GIT_PROTOCOL = "https"

# Build Configuration - Fix linker issues
PACKAGECONFIG:remove:pn-libpcre = "pcregrep pcretest"
PACKAGECONFIG:remove:pn-nativesdk-libpcre = "pcregrep pcretest"

# Disable problematic Qt features for nativesdk builds
PACKAGECONFIG:remove:pn-nativesdk-qtbase = "gui widgets"

# Additional fixes for nativesdk builds
PACKAGECONFIG:remove:pn-nativesdk-libpcre = "pcregrep pcretest pcrecpp_unittest pcre_scanner_unittest pcre_stringpiece_unittest"
PACKAGECONFIG:remove:pn-libpcre = "pcregrep pcretest pcrecpp_unittest pcre_scanner_unittest pcre_stringpiece_unittest"

# Disable tests for problematic packages
PACKAGECONFIG:remove:pn-nativesdk-libpcre = "tests"
PACKAGECONFIG:remove:pn-libpcre = "tests"

# User Account Configuration
EXTRA_USERS_PARAMS = "\
    useradd -p '$(openssl passwd -1 root)' root; \
    usermod -s /bin/bash root; \
    useradd -p '$(openssl passwd -1 nuc123)' -G wheel,audio,video nuc; \
    usermod -s /bin/bash nuc; \
"

# Enable empty passwords for root
EXTRA_IMAGE_FEATURES += "debug-tweaks"

# SystemD and Init System
DISTRO_FEATURES:append = " systemd rauc"
DISTRO_FEATURES_BACKFILL_CONSIDERED += "sysvinit"
VIRTUAL-RUNTIME_init_manager = "systemd"
VIRTUAL-RUNTIME_initscripts = "systemd-compat-units"

# Network Configuration - Enable systemd-networkd
PACKAGECONFIG:append:pn-systemd = " networkd resolved"
PACKAGECONFIG:remove:pn-systemd = "nss-mymachines"

# Qt5 Configuration - OpenGL, KMS, and hardware acceleration support
DISTRO_FEATURES:append = " opengl kde"
MACHINE_FEATURES:append = " drm"

# Package Installation
IMAGE_INSTALL:append = " intel-nuc-init rauc systemd-conf dlt-daemon"

# SDK/Toolchain Configuration - Include DLT in toolchain
TOOLCHAIN_TARGET_TASK:append = " dlt-daemon-dev"
SDK_INCLUDE_PKGS:append = " dlt-daemon-dev"

# RAUC Configuration
RAUC_BUNDLE_VERSION = "0.0.1"
RAUC_BUNDLE_DESCRIPTION = "Intel NUC"
RAUC_BUNDLE_COMPATIBLE = "intel-i7-x64-nuc-rauc"

# Rootfs Configuration
IMAGE_ROOTFS_EXTRA_SPACE = "1048576"
IMAGE_ROOTFS_SIZE = "4096000"

# GRUB Configuration
PREFERRED_PROVIDER_virtual/grub-bootconf = "rauc-qemu-grubconf"
EFI_PROVIDER = "grub-efi"
# Additional kernel cmdline parameters (empty by default)
GRUB_RAUC_BOOT_CMD = "quiet"

# Image and WIC Configuration
WKS_FILE = "image-installer.wks.in"
IMAGE_FSTYPES:append = " ext4"
IMAGE_TYPEDEP_wic = "ext4"
DEPLOYABLE_IMAGE_TYPES = "ext4 wic"

# Initramfs Configuration
INITRD_IMAGE_LIVE = "core-image-minimal-initramfs"
do_image_wic[depends] += "${INITRD_IMAGE_LIVE}:do_image_complete"
do_rootfs[depends] += "virtual/kernel:do_deploy"

# Console Configuration
SERIAL_CONSOLES = ""

# Boot Files Configuration
IMAGE_BOOT_FILES:append = "\
    ${KERNEL_IMAGETYPE} \
    microcode.cpio \
    ${IMGDEPLOYDIR}/${IMAGE_BASENAME}-${MACHINE}.ext4;rootfs.img \
    ${@bb.utils.contains('EFI_PROVIDER', 'grub-efi', 'grub-efi-bootx64.efi;EFI/BOOT/bootx64.efi', '', d)} \
    ${@bb.utils.contains('EFI_PROVIDER', 'grub-efi', 'grub.cfg;EFI/BOOT/grub.cfg', '', d)} \
    ${@bb.utils.contains('EFI_PROVIDER', 'systemd-boot', 'systemd-bootx64.efi;EFI/BOOT/bootx64.efi', '', d)} \
    ${@bb.utils.contains('EFI_PROVIDER', 'systemd-boot', '${IMAGE_ROOTFS}/boot/loader/loader.conf;loader/loader.conf ', '', d)} \
    ${@bb.utils.contains('EFI_PROVIDER', 'systemd-boot', '${IMAGE_ROOTFS}/boot/loader/entries/boot.conf;loader/entries/boot.conf', '', d)} " 
```

## kirkstone/meta-qt5-app/conf/layer.conf
```bitbake
# We have a conf and classes directory, add to BBPATH
BBPATH .= ":${LAYERDIR}"

# We have recipes-* directories, add to BBFILES
BBFILES += "${LAYERDIR}/recipes-*/*/*.bb \
            ${LAYERDIR}/recipes-*/*/*.bbappend"

BBFILE_COLLECTIONS += "meta-qt5-app"
BBFILE_PATTERN_meta-qt5-app = "^${LAYERDIR}/"
BBFILE_PRIORITY_meta-qt5-app = "7"

LAYERSERIES_COMPAT_meta-qt5-app = "kirkstone"
LAYERDEPENDS_meta-qt5-app = "core meta-qt5" 
```

## kirkstone/meta-rauc-cmake/conf/layer.conf
```bitbake
# We have a conf and classes directory, add to BBPATH
BBPATH .= ":${LAYERDIR}"

# We have recipes-* directories, add to BBFILES
BBFILES += "${LAYERDIR}/recipes-*/*/*.bb \
            ${LAYERDIR}/recipes-*/*/*.bbappend"

BBFILE_COLLECTIONS += "meta-rauc-cmake"
BBFILE_PATTERN_meta-rauc-cmake = "^${LAYERDIR}/"
BBFILE_PRIORITY_meta-rauc-cmake = "7"

LAYERVERSION_meta-rauc-cmake = "1"
LAYERSERIES_COMPAT_meta-rauc-cmake = "kirkstone"

# Layer dependencies
LAYERDEPENDS_meta-rauc-cmake = "core openembedded-layer"
```
